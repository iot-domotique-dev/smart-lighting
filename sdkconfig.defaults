## sdkconfig.defaults
```kconfig
CONFIG_PARTITION_TABLE_CUSTOM=y
CONFIG_PARTITION_TABLE_CUSTOM_FILENAME="partitions_zigbee.csv"
CONFIG_PARTITION_TABLE_FILENAME="partitions_zigbee.csv"
CONFIG_PARTITION_TABLE_OFFSET=0x8000
CONFIG_ESPTOOLPY_FLASHSIZE_8MB=y
CONFIG_ZB_ENABLED=y
CONFIG_ESP_MAIN_TASK_STACK_SIZE=8192
```
